## services/boot/Kconfig
```kconfig
config SERVICE_BOOT
	bool "Enable booting"
	default y
	select SERVICE_OPENSBI
        select SERVICE_DDR
	help
                This feature enables support for bootstrapping the U54 application harts. This
                is enabled by default.

menu "Boot Service"
    visible if SERVICE_BOOT

config SERVICE_BOOT_SPI_FLASH_OFFSET
    hex "Copy payload from SPI FLASH at offset"
    default  0x400
    depends on SERVICE_SPI
    help
                This feature specifies the offset in SPI Flash where a boot image is stored.

config SERVICE_BOOT_USE_PAYLOAD
    bool "Use Payload Boot"
    default  n
    depends on SERVICE_BOOT
    help
                This feature enables booting a directly contained payload.

config SERVICE_BOOT_USE_PAYLOAD_IN_FABRIC
    bool "Use Payload in Fabric"
    default  n
    depends on SERVICE_BOOT_USE_PAYLOAD
    help
            This feature enables booting a payload contained in the fabric.

config SERVICE_BOOT_USE_PAYLOAD_IN_FABRIC_ADDRESS
    hex "Payload Fabric Address"
    default  0x400
    depends on SERVICE_BOOT_USE_PAYLOAD_IN_FABRIC
    help
            This feature specifies the address for a payload contained in the fabric.

config SERVICE_BOOT_CUSTOM_FLOW
    bool "Use Custom Boot Flow"
    default  n
    depends on SERVICE_BOOT
    help
                This feature enables custom booting flow where all HARTs
                will jump to same entry point in M-mode.

config SERVICE_BOOT_DDR_TARGET_ADDR
	hex "Target Base address for BOOT to DDR copy"
	default 0x103FC00000
	depends on SERVICE_BOOT
	help
                This feature specifies a scratch address for EMMC/QSPI decompression

config SERVICE_BOOT_MMC_USE_GPT
    bool "Use GPT with MMC"
    default SERVICE_BOOT && SERVICE_MMC && y
	depends on SERVICE_MMC
	help
		If CONFIG_SERVICE_MMC is enabled, then for MMC boots this option enables
                parsing of a GUID Partition Table (GPT) in search of the boot image starting
                sector..

menuconfig BOOT_PARAMS
	bool "Boot Parameters (Bootloader 0)"
	default n
	depends on SERVICE_BOOT && SERVICE_MMC && SERVICE_QSPI && SERVICE_QSPI_INFINEON_S25FL
	help
		If enabled, the HSS builds the Bootloader 0 BSP modules shared
		with the application (boards/<board>/bsp/: Boot Parameters
		record store, Bootloader log and payload MD5 verification) and
		drives the automatic boot from the Boot Parameters: the
		boot_sequence[] entries (MSS eMMC / fabric eMMC / golden QSPI)
		are attempted in order (boot_sequence[0] is a one-shot
		override, cleared once attempted) and boot attempts are
		recorded back into the store (current_try / last_failed /
		last_successful). If the Boot Parameters cannot be read, the
		stock boot flow runs instead.

		Requires the MMC service and the QSPI service with the
		Infineon S25FL driver.

		If disabled, the stock HSS boot flow is used.

		If you do not know what to do here, say N.

config BOOT_PARAMS_MD5_VERIFY
	bool "Verify boot image MD5 before booting"
	default y
	depends on BOOT_PARAMS
	help
		If enabled, each boot image loaded from a boot_sequence[] entry
		is streamed again from its storage and its MD5 digest checked
		against the md5Sum in the HSS image header (written by
		hss-payload-generator). An image that fails is never booted:
		the entry is recorded in last_failed with BOOT_ERR_MD5_VERIFY
		and the next boot_sequence[] entry is tried.

		Verification also requires integrity_check_en in the Boot
		Parameters (enabled by default), so the application can still
		turn it off at run time. It is not applied to the stock boot
		flow used when the Boot Parameters cannot be read.

		If disabled, the MD5 check is not built in and images boot
		unverified; a warning is logged when the Boot Parameters
		request the check.

		If you do not know what to do here, say Y.

# Hidden inverse of BOOT_PARAMS_MD5_VERIFY, which is what the C code tests.
# Kconfig writes no CONFIG_ line for a disabled bool, so a config.h that
# predates BOOT_PARAMS_MD5_VERIFY cannot be told apart from one with it
# disabled. Keying the code off this inverse keeps the MD5 check built in
# for such a stale config.h instead of silently dropping it.
config BOOT_PARAMS_MD5_VERIFY_DISABLED
	def_bool !BOOT_PARAMS_MD5_VERIFY
	depends on BOOT_PARAMS

menuconfig BOOT_PARAMS_LOG
	bool "Write boot events to the Flash boot log"
	default y
	depends on BOOT_PARAMS
	help
		If enabled, the Boot Parameters driven boot appends its boot
		events to the Bootloader log (BOOT_log_write, NAND Flash when
		BOOT_PARAMS_NAND is defined in boards/<board>/bsp/BSP_Config.h)
		in addition to printing them on the console: boot start, each
		boot_sequence[] entry tried, MD5 results, rejections with their
		reason, and the entry that booted. The application reads the
		same log back with BOOT_log_read.

		Each record is stored as "<E|W|I> <message>". Only events at or
		above "Boot log level" are written. A failed log write is
		reported on the console and disables the log for the rest of
		that boot; it never blocks the boot.

		If you do not know what to do here, say Y.

choice
	prompt "Boot log level"
	default BOOT_PARAMS_LOG_LEVEL_INFO
	depends on BOOT_PARAMS_LOG
	help
		Selects which boot events are written to the Flash boot log.
		Console output is not affected.

		A NAND log record takes one 8 KB page, so with the default 2 MB
		log about 254 records are kept: at "Info" (about 5 records per
		normal boot) that is roughly the last 50 boots.

config BOOT_PARAMS_LOG_LEVEL_ERROR
	bool "Error"
	help
		Rejected boot entries, store failures and boot failures only.
		A boot without errors writes nothing.

config BOOT_PARAMS_LOG_LEVEL_WARN
	bool "Warning"
	help
		Errors, plus warnings such as an image booting unverified
		because MD5 verification is disabled in this build.

config BOOT_PARAMS_LOG_LEVEL_INFO
	bool "Info"
	help
		Every boot event: errors, warnings, the boot start summary,
		each entry tried, MD5 verified and the entry that booted.

endchoice

config BOOT_PARAMS_LOG_LEVEL
	int
	depends on BOOT_PARAMS_LOG
	default 1 if BOOT_PARAMS_LOG_LEVEL_ERROR
	default 2 if BOOT_PARAMS_LOG_LEVEL_WARN
	default 3

config BOOT_PARAMS_LOG_NAND_BASE_ADDR
	hex "Boot log NAND base address"
	default 0xFFD00000
	range 0x0 0xFFE00000
	depends on BOOT_PARAMS_LOG
	help
		Byte address in NAND Flash where the boot log ring starts.
		Becomes BOOT_LOG_NAND_BASE_ADDR in boards/<board>/bsp/
		BSP_Config.h.

		Must be aligned to a NAND erase block (1 MB, 0x100000). The log
		must lie inside the first 4 GB of the NAND and must not overlap
		the Boot Parameters block (block 4095 at 0xFFF00000), which is
		checked at build time. In the application, block 4092
		(0xFFC00000) is used by the NAND unit tests.

		The default, 0xFFD00000 (blocks 4093-4094), sits directly below
		the Boot Parameters block.

		The application reads this log: keep BOOT_LOG_NAND_BASE_ADDR in
		the application's BSP_Config.h equal to this value.

		Only used with the NAND backend (BOOT_PARAMS_NAND); the QSPI NOR
		backend keeps its fixed log region.

config BOOT_PARAMS_LOG_NAND_SIZE
	hex "Boot log NAND size (bytes)"
	default 0x200000
	range 0x200000 0xFFF00000
	depends on BOOT_PARAMS_LOG
	help
		Size in bytes of the NAND boot log ring. Becomes
		BOOT_LOG_NAND_SIZE in boards/<board>/bsp/BSP_Config.h.

		Must be a whole number of NAND erase blocks (1 MB, 0x100000),
		and at least 2 blocks so a rotation never erases the only
		block holding records. Each block keeps 127 records (one 8 KB
		page each, plus a header page); a rotation erases the oldest
		block. Each log write scans the ring, so a larger log costs a
		little more time per record.

		The default, 0x200000 (2 MB), is 2 blocks.

		The application reads this log: keep BOOT_LOG_NAND_SIZE in the
		application's BSP_Config.h equal to this value.

		Only used with the NAND backend (BOOT_PARAMS_NAND).

endmenu
```
